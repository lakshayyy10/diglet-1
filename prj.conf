## CMakeLists.txt
```
cmake_minimum_required(VERSION 3.20.0)

# Optional: set device tree overlay file
set(DTC_OVERLAY_FILE ${CMAKE_CURRENT_SOURCE_DIR}/boards/app.overlay)

find_package(Zephyr REQUIRED HINTS $ENV{ZEPHYR_BASE})
project(agriprobe_biobox)

target_include_directories(app PRIVATE include)
target_sources(app PRIVATE src/main.c)

# Build other sources from src/
add_subdirectory(src)
```

## west.yml
```
manifest:

  projects:
    - name: zephyr
      url: https://github.com/zephyrproject-rtos/zephyr
      revision: v4.0.0
      path: zephyr
      west-commands: scripts/west-commands.yml
      import: 
        name-allowlist:
          - cmsis
          - hal_stm32
  self:
    path: Diglet
```

## prj.conf
```kconfig
CONFIG_MAIN_STACK_SIZE=2048
CONFIG_SYSTEM_WORKQUEUE_STACK_SIZE=2048

# Enable logging
CONFIG_LOG=y
CONFIG_LOG_DEFAULT_LEVEL=3

# Enable Stepper API
CONFIG_STEPPER=y

# Enable PWM for DC motors
CONFIG_PWM=y
```

## boards/app.overlay
```dts
/ {
    aliases {
        stepper0 = &stepper_motor;
    };

    stepper_motor: stepper-motor {
        compatible = "stepper-motor";
        status = "okay";
        dir-gpios = <&gpiob 7 GPIO_ACTIVE_LOW>;
        step-gpios = <&gpioc 0 GPIO_ACTIVE_LOW>;
    };
};
```

## src/main.c
```c
#include <stdint.h>
#include <stdio.h>
#include <string.h>
#include <zephyr/device.h>
#include <zephyr/devicetree.h>
#include <zephyr/drivers/gpio.h>
#include <zephyr/kernel.h>
#include <zephyr/kernel/thread_stack.h>
#include <zephyr/sys/printk.h>
#include <zephyr/sys/util.h>

#define STACK_SIZE 4096
#define PRIORITY 2
#define STEPPER_TIMER 100

struct stepper_motor {
  struct gpio_dt_spec dir;
  struct gpio_dt_spec step;
};

enum StepperDirection {
  STOP_PULSE = 0,
  HIGH_PULSE = 1,
  LOW_PULSE = 2
};

const struct stepper_motor stepper = {
  .dir = GPIO_DT_SPEC_GET(DT_ALIAS(stepper0), dir_gpios),
  .step = GPIO_DT_SPEC_GET(DT_ALIAS(stepper0), step_gpios)
}; // Missing semicolon here

K_THREAD_STACK_DEFINE(stack_area, STACK_SIZE);
struct k_work_q work_q;
int stepper_pos = 0;
enum StepperDirection stepper_dir = STOP_PULSE;
struct k_work stepper_work_item;

int Stepper_motor_write(const struct stepper_motor *motor, enum StepperDirection dir, int pos) {
  if (dir == STOP_PULSE) {
    return pos;
  }
  if (dir == HIGH_PULSE) {
    gpio_pin_set_dt(&(motor->dir), 1); // clockwise
    pos += 1;
  } else {
    gpio_pin_set_dt(&(motor->dir), 0); // anti-clockwise
    pos -= 1;
  }
  
  switch (pos & 0x03) {
  case 0:
    gpio_pin_set_dt(&(motor->step), 0);
    break;
  case 1:
    gpio_pin_set_dt(&(motor->step), 1);
    break;
  case 2:
    gpio_pin_set_dt(&(motor->step), 1);
    break;
  case 3:
    gpio_pin_set_dt(&(motor->step), 0);
    break;
  }
  return pos;
}

void stepper_work_handler(struct k_work *work_ptr) {
  stepper_pos = Stepper_motor_write(&stepper, stepper_dir, stepper_pos);
}

void stepper_timer_handler(struct k_timer *stepper_timer_ptr) {
  k_work_submit_to_queue(&work_q, &stepper_work_item);
}

K_TIMER_DEFINE(stepper_timer, stepper_timer_handler, NULL);

int main() {
  
  printk("Stepper Motor Control\n");
  k_work_queue_init(&work_q);
  k_work_init(&stepper_work_item, stepper_work_handler);
  if (!device_is_ready(stepper.dir.port)) {
    printk("Direction GPIO port not ready\n");
    return 0;
  }
  if (!device_is_ready(stepper.step.port)) {
    printk("Step GPIO port not ready\n");
    return 0;
  }
  if (gpio_pin_configure_dt(&(stepper.dir), GPIO_OUTPUT_INACTIVE)) {
    printk("Direction pin not configured\n");
    return 0;
  }
  if (gpio_pin_configure_dt(&(stepper.step), GPIO_OUTPUT_INACTIVE)) {
    printk("Step pin not configured\n");
    return 0;
  }
  k_work_queue_start(&work_q, stack_area, K_THREAD_STACK_SIZEOF(stack_area),
                     PRIORITY, NULL);
  k_timer_start(&stepper_timer, K_SECONDS(1), K_USEC(STEPPER_TIMER / 2));
  
  while (1) {
    printk("clockwise\n");
    stepper_dir = HIGH_PULSE;
    k_sleep(K_SECONDS(5));
    printk("Stopped\n");
    stepper_dir = STOP_PULSE;
    k_sleep(K_SECONDS(2));
    printk("anticlockwise\n");
    stepper_dir = LOW_PULSE;
    k_sleep(K_SECONDS(5));
    printk("Stopped\n");
    stepper_dir = STOP_PULSE;
    k_sleep(K_SECONDS(2));
  }
  
  return 0;
}
```

## include/2sep.h
```c
#ifndef STEPPER_CONTROL_H
#define STEPPER_CONTROL_H

#include <zephyr/device.h>
#include <zephyr/drivers/gpio.h>

struct stepper_motor {
    struct gpio_dt_spec dir;  /* Direction pin */
    struct gpio_dt_spec step; /* Step pin */
};

void stepper_init(void);

int stepper_motor_write(const struct stepper_motor *motor, uint16_t cmd, int pos);
void stepper_move_to_tube(uint8_t tube_number);

#endif /* STEPPER_CONTROL_H */
```

## include/basic.h
```c
#ifndef BASIC_STEPPER_H
#define BASIC_STEPPER_H

#include <zephyr/device.h>
#include <zephyr/drivers/gpio.h>

/* Stepper motor structure definition */
struct stepper_motor {
    struct gpio_dt_spec dir;
    struct gpio_dt_spec step;
};

/**
 * @brief Initialize stepper motor
 */
void stepper_init(void);

/**
 * @brief Move stepper motor based on command value
 * 
 * @param motor Pointer to stepper motor structure
 * @param cmd Command value (500 for CCW, 950 for stop, 1500 for CW)
 * @param pos Current position
 * @return Updated position
 */
int stepper_motor_write(const struct stepper_motor *motor, uint16_t cmd, int pos);

/**
 * @brief Set stepper motor direction and speed
 * 
 * @param direction 0: stop, 1: clockwise, -1: counterclockwise
 */
void stepper_set_direction(int direction);

#endif /* BASIC_STEPPER_H */
```

## include/dc_control.h
```c
#ifndef DC_MOTOR_CONTROL_H
#define DC_MOTOR_CONTROL_H

void dc_motor_init(void);

#endif
```

## include/stepper_control.h
```c
/*
 * Stepper motor control header file
 */

#ifndef STEPPER_CONTROL_H
#define STEPPER_CONTROL_H

#include <zephyr/device.h>
#include <zephyr/drivers/gpio.h>

/** 
 * @brief Structure for stepper motor pin configuration
 */
struct stepper_motor {
    struct gpio_dt_spec dir;  /* Direction pin */
    struct gpio_dt_spec step; /* Step pin */
};

/**
 * @brief Initialize the stepper motor
 */
void stepper_init(void);

/**
 * @brief Write to stepper motor
 *
 * @param motor Pointer to stepper motor structure
 * @param cmd Command value (1500 for clockwise, 500 for anti-clockwise)
 * @param pos Current position
 * @return New position
 */
int stepper_motor_write(const struct stepper_motor *motor, uint16_t cmd, int pos);

#endif /* STEPPER_CONTROL_H */
```

## src/1.c
```c
#include<zephyr/kernel.h>
#include<zephyr/device.h>
#include<zephyr/drivers/gpio.h>
#include<zephyr/logging/log.h>
#include "stepper_control.h"

log_module_register(stepper, config_stepper_log_level);

#define num_test 5
#define steps_per_revolution 200
#define steps_per (steps_per_revolution/num_test)
#define drop_time 3000

const struct stepper_motor stepper_dev = {
  .dir = gpio_dt_spec_get(dt_alias(stepper0), dir_gpios),
  .step = gpio_dt_spec_get(dt_alias(stepper0), step_gpios)
};

static uint8_t current_tube = 0;
static int32_t current_position = 0;
static int pos = 0;

static void move(struct k_work *work);
k_work_delayable_define(tube_work, move);

static void move(struct k_work *work)
{
    current_tube = (current_tube+1) % num_testt;
    printk("moving to tube %d\n", current_tube);
    int32_t next_pos = current_tube * steps_per;
    int steps_to_move = next_pos - current_position;
    if (steps_to_move > 0) {
        gpio_pin_set_dt(&(stepper_dev.dir), 1);  // clockwise
    } else {
        gpio_pin_set_dt(&(stepper_dev.dir), 0);  // anti-clockwise
        steps_to_move = -steps_to_move;  // make steps positive for the loop
    }
    for (int i = 0; i < steps_to_move; i++) {
        pos = _stepper_motor_write(&stepper_dev, (steps_to_move > 0) ? 1500 : 500, pos);
        k_sleep(k_msec(1));  // small delay between steps
    }
    current_position = next_pos;
    printk("position of tube is : %d (tube %d)\n", current_position, current_tube);
    k_work_schedule(&tube_work, k_msec(drop_time));
}

void stepper_init(void)
{
    // configure gpio pins
    if (!gpio_is_ready_dt(&stepper_dev.dir) || !gpio_is_ready_dt(&stepper_dev.step)) {
        printk("stepper gpio not ready\n");
        return;
    }
    if (gpio_pin_configure_dt(&(stepper_dev.dir), gpio_output_inactive) ||
        gpio_pin_configure_dt(&(stepper_dev.step), gpio_output_inactive)) {
        printk("error configuring stepper gpio\n");
        return;
    }
    printk("stepper ready\n");
    current_position = 0;
    k_work_schedule(&tube_work, k_msec(drop_time));
}
```

## src/dc_control.c
```c
#include <zephyr.h>
#include <device.h>
#include <drivers/pwm.h>
#include "dc_control.h"

#define MOTOR_PWM_NODE DT_ALIAS(pwm0)
#define MOTOR_PWM_LABEL DT_LABEL(MOTOR_PWM_NODE)

const struct device *pwm_dev;

void dc_motor_init(void) {
    pwm_dev = device_get_binding(MOTOR_PWM_LABEL);
}
```

## src/stepper_control.c
```c
#include <zephyr/kernel.h>
#include <zephyr/device.h>
#include <zephyr/drivers/gpio.h>
#include <zephyr/logging/log.h>
#include <stdlib.h>
#include "stepper_control.h"

LOG_MODULE_REGISTER(stepper, CONFIG_STEPPER_LOG_LEVEL);

#define NUM_TEST 5
#define STEPS_PER_REVOLUTION 200
#define STEPS_PER (STEPS_PER_REVOLUTION/NUM_TEST)
#define DROP_TIME 100

/* Tarzan Channel values */
static uint16_t channel_range[] = {0, 950, 2047};

const struct stepper_motor stepper_dev = {
  .dir = GPIO_DT_SPEC_GET(DT_ALIAS(stepper0), dir_gpios),
  .step = GPIO_DT_SPEC_GET(DT_ALIAS(stepper0), step_gpios)
};

static uint8_t current_tube = 0;
static int32_t current_position = 0;
static int pos = 0;
static int target_position = 0;
static uint16_t step_cmd = 950; 

static void stepper_step_handler(struct k_work *work);
K_WORK_DEFINE(step_work, stepper_step_handler);

static void tube_change_handler(struct k_timer *dummy);
K_TIMER_DEFINE(tube_timer, tube_change_handler, NULL);

static void stepper_pulse_handler(struct k_timer *dummy);
K_TIMER_DEFINE(stepper_timer, stepper_pulse_handler, NULL);

int stepper_motor_write(const struct stepper_motor *motor, uint16_t cmd, int pos) {
  if (abs(cmd - channel_range[1]) < 200) {
    return pos;
  }
  
  if (cmd > channel_range[1]) {
    gpio_pin_set_dt(&(motor->dir), 1); // clockwise
    pos += 1;
  } else {
    gpio_pin_set_dt(&(motor->dir), 0); // anti-clockwise
    pos -= 1;
  }
  
  switch (pos & 0x03) {
  case 0:
    gpio_pin_set_dt(&(motor->step), 0);
    break;
  case 1:
    gpio_pin_set_dt(&(motor->step), 1);
    break;
  case 2:
    gpio_pin_set_dt(&(motor->step), 1);
    break;
  case 3:
    gpio_pin_set_dt(&(motor->step), 0);
    break;
  }
  
  return pos;
}

static void stepper_step_handler(struct k_work *work) {
  pos = stepper_motor_write(&stepper_dev, step_cmd, pos);
  
  if (current_position == target_position) {
    step_cmd = 950; // Stop
    printk("Position reached: %d (tube %d)\n", current_position, current_tube);
  } else if (current_position < target_position) {
    step_cmd = 1500; // Move clockwise
    current_position++;
  } else {
    step_cmd = 500;  // Move counterclockwise
    current_position--;
  }
}

static void stepper_pulse_handler(struct k_timer *dummy) {
  k_work_submit(&step_work);
}

static void tube_change_handler(struct k_timer *dummy) {
  current_tube = (current_tube + 1) % NUM_TEST;
  printk("Moving to tube %d\n", current_tube);
  
  target_position = current_tube * STEPS_PER;
  
  k_timer_start(&stepper_timer, K_NO_WAIT, K_USEC(800)); // Adjust pulse frequency as needed
}

void stepper_init(void)
{
  if (!gpio_is_ready_dt(&stepper_dev.dir) || !gpio_is_ready_dt(&stepper_dev.step)) {
    printk("Stepper GPIO not ready\n");
    return;
  }
  
  if (gpio_pin_configure_dt(&(stepper_dev.dir), GPIO_OUTPUT_INACTIVE) ||
      gpio_pin_configure_dt(&(stepper_dev.step), GPIO_OUTPUT_INACTIVE)) {
    printk("GPIO configuration failed\n");
    return;
  }
  
  printk("Stepper ready\n");
  current_position = 0;
  target_position = 0;
  
  k_timer_start(&tube_timer, K_MSEC(DROP_TIME), K_MSEC(DROP_TIME));
}
void stepper_move_to_tube(uint8_t tube_number) {
  if (tube_number < NUM_TEST) {
    current_tube = tube_number;
    target_position = current_tube * STEPS_PER;
    k_timer_start(&stepper_timer, K_NO_WAIT, K_USEC(50));
  }
}
```
